## sdkconfig.defaults
```kconfig
CONFIG_ESP_DEFAULT_CPU_FREQ_MHZ=240
CONFIG_ESP_DEFAULT_CPU_FREQ_MHZ_240=y
CONFIG_ESP32S3_DEFAULT_CPU_FREQ_240=y

CONFIG_SPIRAM=y
CONFIG_ESP32S3_SPIRAM_SUPPORT=y
CONFIG_SPIRAM_MODE_OCT=y
CONFIG_SPIRAM_OCCUPY_SPI_HOST=1
CONFIG_SPIRAM_SPEED_80M=y
CONFIG_SPIRAM_IGNORE_NOTFOUND=y
CONFIG_SPIRAM_USE_CAPS_ALLOC=y
; WiFi/LWIP data-path buffers -> PSRAM (DMA-critical parts stay internal)
CONFIG_SPIRAM_TRY_ALLOCATE_WIFI_LWIP=y
CONFIG_SPIRAM_CACHE_WORKAROUND=y

CONFIG_ESPTOOLPY_FLASHSIZE_8MB=y
CONFIG_ESPTOOLPY_FLASHSIZE="8MB"

CONFIG_PARTITION_TABLE_CUSTOM=y
CONFIG_PARTITION_TABLE_CUSTOM_FILENAME="partitions.csv"
CONFIG_PARTITION_TABLE_FILENAME="partitions.csv"
CONFIG_PARTITION_TABLE_OFFSET=0x8000
CONFIG_PARTITION_TABLE_MD5=y

; LVGL is configured via lv_conf.h (skip its Kconfig)
CONFIG_LV_CONF_SKIP=y

; NTP for cell timestamps
CONFIG_LWIP_SNTP_UPDATE_DELAY=1000000

; --------------------------------------------------------------------
; Bluetooth / NimBLE (passive BLE scan only, observer role)
; --------------------------------------------------------------------
CONFIG_BT_ENABLED=y
CONFIG_BT_CONTROLLER_ENABLED=y
CONFIG_BT_NIMBLE_ENABLED=y

; Bluedroid NE legyen
# CONFIG_BT_BLUEDROID_ENABLED is not set

; Csak scanner / Observer
CONFIG_BT_NIMBLE_ROLE_OBSERVER=y

; Ezeket nem hasznaljuk
# CONFIG_BT_NIMBLE_ROLE_CENTRAL is not set
# CONFIG_BT_NIMBLE_ROLE_PERIPHERAL is not set
# CONFIG_BT_NIMBLE_ROLE_BROADCASTER is not set

; GATT nem kell BTHome advertisement vetelehez
# CONFIG_BT_NIMBLE_GATT_CLIENT is not set
# CONFIG_BT_NIMBLE_GATT_SERVER is not set

; Security / pairing nem kell
# CONFIG_BT_NIMBLE_SECURITY_ENABLE is not set

; BLE Mesh nem kell
# CONFIG_BLE_MESH is not set

; Nem-kritikus host memoria PSRAM-ba (belső RAM marad a WiFi-nek)
CONFIG_BT_NIMBLE_MEM_ALLOC_MODE_EXTERNAL=y

; Host task
CONFIG_BT_NIMBLE_HOST_TASK_STACK_SIZE=4096

; Controller karcsusitas scannerhez (826B/instance, kevesebb dup-lista)
CONFIG_BT_CTRL_BLE_MAX_ACT=1
CONFIG_BT_CTRL_SCAN_DUPL_CACHE_SIZE=10

; main task runs BT-controller init, LVGL rebuilds and MQTT starts
; (4KB overflowed: "stack overflow in task main" boot loop)
CONFIG_ESP_MAIN_TASK_STACK_SIZE=8192
; faster/more reliable HTTP firmware uploads over a weak STA link
CONFIG_LWIP_TCP_WND_DEFAULT=32768
CONFIG_LWIP_TCP_SND_BUF_DEFAULT=32768
CONFIG_LWIP_SO_RCVBUF=y
CONFIG_LWIP_SO_SNDBUF=y


CONFIG_ESPTOOLPY_FLASHMODE_DIO=y
CONFIG_ESPTOOLPY_FLASHMODE="DIO"
CONFIG_ESPTOOLPY_FLASHFREQ_40M=y
CONFIG_ESPTOOLPY_FLASHFREQ="40M"
CONFIG_SPIRAM_XIP_FROM_PSRAM=y
CONFIG_SPIRAM_RODATA=y

CONFIG_ESP32S3_DATA_CACHE_16KB=y
```

## sdkconfig.defaults.safeboot
```kconfig
; safeboot stub build: strip everything not needed by the recovery stub
CONFIG_ESPTOOLPY_FLASHSIZE_8MB=y
CONFIG_ESPTOOLPY_FLASHSIZE="8MB"
CONFIG_ESPTOOLPY_FLASHMODE_DIO=y
CONFIG_ESPTOOLPY_FLASHMODE="DIO"
CONFIG_ESPTOOLPY_FLASHFREQ_40M=y
CONFIG_ESPTOOLPY_FLASHFREQ="40M"

CONFIG_PARTITION_TABLE_CUSTOM=y
CONFIG_PARTITION_TABLE_CUSTOM_FILENAME="partitions.csv"
CONFIG_PARTITION_TABLE_FILENAME="partitions.csv"
CONFIG_PARTITION_TABLE_OFFSET=0x8000
CONFIG_PARTITION_TABLE_MD5=y

CONFIG_BT_ENABLED=n
CONFIG_LV_CONF_SKIP=y

; keep the stub flash friendly: no console scrollback, no extra logging
CONFIG_LOG_DEFAULT_LEVEL_NONE=n
CONFIG_LOG_DEFAULT_LEVEL_INFO=y
```
